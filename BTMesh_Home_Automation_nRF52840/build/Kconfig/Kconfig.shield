## BTMesh_Home_Automation_nRF52840/build/Kconfig/Kconfig.shield
```kconfig
osource "d:/workspace/nrfconnect/testing1/light_2_3/boards/arm/custom_home_automation/boards/shields/*/Kconfig.shield"
osource "d:/workspace/nrfconnect/testing1/light_2_3/boards/shields/*/Kconfig.shield"
osource "d:/workspace/nrfconnect/testing1/light_switch_2_3/boards/shields/*/Kconfig.shield"
osource "d:/workspace/nrfconnect/testing1/light_2_3_test/boards/shields/*/Kconfig.shield"
osource "d:/workspace/nrfconnect/testing1/btmesh_home_automation_nrf52840/boards/shields/*/Kconfig.shield"
osource "C:/ncs/v2.3.0/nrf/boards/shields/*/Kconfig.shield"
```

## BT_Mesh_Home_Automation/build/Kconfig/Kconfig.shield
```kconfig
osource "d:/workspace/nrfconnect/testing1/light_2_3/boards/arm/custom_home_automation/boards/shields/*/Kconfig.shield"
osource "c:/users/hp/onedrive/desktop/freelancing/git_pushes/bluetooth_mesh/bt_mesh_home_automation/boards/shields/*/Kconfig.shield"
osource "C:/ncs/v2.3.0/nrf/boards/shields/*/Kconfig.shield"
```

## BT_Mesh_Home_Automation/build/Kconfig/Kconfig.shield.defconfig
```kconfig
osource "d:/workspace/nrfconnect/testing1/light_2_3/boards/arm/custom_home_automation/boards/shields/*/Kconfig.defconfig"
osource "c:/users/hp/onedrive/desktop/freelancing/git_pushes/bluetooth_mesh/bt_mesh_home_automation/boards/shields/*/Kconfig.defconfig"
osource "C:/ncs/v2.3.0/nrf/boards/shields/*/Kconfig.defconfig"
```
